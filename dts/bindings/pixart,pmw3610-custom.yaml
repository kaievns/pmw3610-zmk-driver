## dts/bindings/pixart,pmw3610-custom.yaml
```yaml
description: |
  PixArt PMW3610 ultra-low-power optical motion sensor (trackball).
  SPI device with 3-wire SDIO (connect MOSI and MISO to the same SDIO line).

compatible: "pixart,pmw3610-custom"

include: spi-device.yaml

properties:
  motion-gpios:
    type: phandle-array
    required: true
    description: Motion interrupt GPIO (active-low).

  cpi:
    type: int
    default: 800
    description: |
      Initial CPI (counts per inch), range 200-3200.
      Must be a multiple of 200.

  invert-x:
    type: boolean
    description: Invert X axis in hardware via the RES_STEP register.

  invert-y:
    type: boolean
    description: Invert Y axis in hardware via the RES_STEP register.

  smart-mode:
    type: boolean
    description: |
      Enable the smart tracking algorithm for improved tracking on
      difficult surfaces. Off by default.
```

## dts/bindings/zmk,input-processor-pmw3610-unpack-xy.yaml
```yaml
description: Splits a packed-XY event from the PMW3610 driver back into
  separate REL_X and REL_Y events. Pass-through for any non-packed event.

compatible: "zmk,input-processor-pmw3610-unpack-xy"

include: ip_zero_param.yaml

properties: {}
```

## modules/drivers/dts/bindings/pixart,pmw3610-custom.yaml
```yaml
description: |
  PixArt PMW3610 ultra-low-power optical motion sensor (trackball).
  SPI device with 3-wire SDIO (connect MOSI and MISO to the same SDIO line).

compatible: "pixart,pmw3610-custom"

include: spi-device.yaml

properties:
  motion-gpios:
    type: phandle-array
    required: true
    description: Motion interrupt GPIO (active-low).

  cpi:
    type: int
    default: 800
    description: |
      Initial CPI (counts per inch), range 200-3200.
      Must be a multiple of 200.
```

## modules/drivers/sensor/pmw3610/Kconfig
```kconfig
menuconfig PMW3610
	bool "PMW3610 mouse optical sensor"
	default n
	depends on GPIO
	depends on INPUT
	help
	  Enable driver for the PixArt PMW3610 optical motion sensor.
	  Uses GPIO bit-bang 3-wire SPI for the bidirectional SDIO line.

if PMW3610

config PMW3610_SWAP_XY
	bool "Swap the X/Y axes"

config PMW3610_INVERT_X
	bool "Invert the X axis"

config PMW3610_INVERT_Y
	bool "Invert the Y axis"

config PMW3610_REPORT_INTERVAL_MIN
	int "Minimum report interval (ms)"
	default 12
	help
	  Rate-limit motion reports for BLE stability.
	  Set to 0 for maximum responsiveness (USB).
	  12 ms works well for BLE split keyboards.

config PMW3610_SMART_ALGORITHM
	bool "Enable surface coverage enhancement algorithm"
	default n
	help
	  Extends tracking across a wider range of surfaces
	  (granites, tiles) at the cost of slightly more power.

config PMW3610_RUN_DOWNSHIFT_TIME_MS
	int "RUN → REST1 downshift time (ms)"
	default 128
	range 32 8160

config PMW3610_REST1_DOWNSHIFT_TIME_MS
	int "REST1 → REST2 downshift time (ms)"
	default 5000

config PMW3610_REST2_DOWNSHIFT_TIME_MS
	int "REST2 → REST3 downshift time (ms)"
	default 17000

config PMW3610_REST1_SAMPLE_TIME_MS
	int "REST1 sample period (ms)"
	default 40

config PMW3610_REST2_SAMPLE_TIME_MS
	int "REST2 sample period (ms)"
	default 100

config PMW3610_REST3_SAMPLE_TIME_MS
	int "REST3 sample period (ms)"
	default 500

module = PMW3610
module-str = PMW3610
source "${ZEPHYR_BASE}/subsys/logging/Kconfig.template.log_config"

endif # PMW3610
```

## src/Kconfig
```kconfig
menuconfig PMW3610
	bool "PMW3610 mouse optical sensor"
	default n
	depends on SPI
	depends on GPIO
	depends on INPUT
	help
	  Enable driver for the PixArt PMW3610 optical motion sensor.
	  Uses hardware SPI with 3-wire SDIO (MOSI/MISO on same pin).

if PMW3610

config PMW3610_REPORT_INTERVAL_MIN
	int "Minimum report interval (ms)"
	default 12
	help
	  Rate-limit motion reports for BLE stability.
	  Set to 0 for maximum responsiveness (USB).
	  12 ms works well for BLE split keyboards.

config PMW3610_PACKED_REPORTS
	bool "Pack X+Y into a single input event"
	default n
	help
	  When enabled, the driver emits one combined event per motion
	  report (custom code PMW3610_REL_PACKED_XY, X in high 16 bits,
	  Y in low 16 bits) instead of two separate REL_X / REL_Y events.
	  Halves the split BLE notify rate for diagonal motion. Requires
	  the matching zip_pmw3610_unpack_xy input processor to run on
	  the consumer side (typically the central) — without it, motion
	  events go nowhere.

config PMW3610_RUN_DOWNSHIFT_TIME_MS
	int "RUN → REST1 downshift time (ms)"
	default 128
	range 32 8160

config PMW3610_REST1_DOWNSHIFT_TIME_MS
	int "REST1 → REST2 downshift time (ms)"
	default 5000

config PMW3610_REST2_DOWNSHIFT_TIME_MS
	int "REST2 → REST3 downshift time (ms)"
	default 17000

config PMW3610_REST1_SAMPLE_TIME_MS
	int "REST1 sample period (ms)"
	default 40

config PMW3610_REST2_SAMPLE_TIME_MS
	int "REST2 sample period (ms)"
	default 100

config PMW3610_REST3_SAMPLE_TIME_MS
	int "REST3 sample period (ms)"
	default 500

module = PMW3610
module-str = PMW3610
source "${ZEPHYR_BASE}/subsys/logging/Kconfig.template.log_config"

endif # PMW3610

# Unpack input processor — built on the consumer side (typically central),
# which doesn't have CONFIG_PMW3610=y, so this stays outside the if-block.
config ZMK_INPUT_PROCESSOR_PMW3610_UNPACK_XY
	bool "Unpack PMW3610 packed-XY events"
	default y if DT_HAS_ZMK_INPUT_PROCESSOR_PMW3610_UNPACK_XY_ENABLED
	help
	  Input processor that splits a packed-XY event back into separate
	  REL_X and REL_Y events for downstream processors and listeners.
	  Pass-through for any non-packed event, so it's safe to leave in
	  the pipeline regardless of whether packing is enabled on the
	  producing side.
```
